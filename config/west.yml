## config/west.yml
```yaml
manifest:
  remotes:
    - name: zmkfirmware
      url-base: https://github.com/zmkfirmware
    - name: tangbonze
      url-base: https://github.com/tangbonze
    - name: oleksandrmaslov
      url-base: https://github.com/oleksandrmaslov
    - name: kumamuk-git
      url-base: https://github.com/kumamuk-git
    - name: kot149
      url-base: https://github.com/kot149
  projects:
    - name: zmk
      remote: zmkfirmware
      revision: v0.3
      import: app/west.yml
    - name: zmk-pmw3610-driver
      remote: tangbonze
      revision: main
    - name: zmk-pointing-acceleration
      remote: oleksandrmaslov
      revision: main
    - name: zmk-scroll-snap
      remote: kot149
      revision: v1
  self:
    path: config
```
